//各型番ごとのI2Cアドレス
enum TypeAddress_e{
  TLE493D_A0 = 0x35,
  TLE493D_A1 = 0x22,
  TLE493D_A2 = 0x78,
  TLE493D_A3 = 0x44
};

class Tle493d{
  public:
    Tle493d(TypeAddress_e address);
    ~Tle493d();
    int x;
    int y;
    int z;
    float r;
    int xRaw;
    int yRaw;
    int zRaw;
    bool begin();
    void update();
    void calibrate();
    bool pole;
    int asobi;

  private:
    TypeAddress_e address;
    int xPrev;
    int yPrev;
    int zPrev;
    int xOffset;
    int yOffset;
    int zOffset;
    void resetSenser();
    bool configSenser();
    int asobiAdj(int axis);
};

/*コンストラクション
変数の初期化が多いのでこの方が読みやすい*/
Tle493d::Tle493d(TypeAddress_e addr){
  x=0;y=0;z=0;r=0;
  xRaw=0;yRaw=0;zRaw=0;
  pole=true;
  xPrev=0;yPrev=0;zPrev=0;
  xOffset=0;yOffset=0;zOffset=0;
  address = addr;
  asobi = 200;
}

Tle493d::~Tle493d(){
}

//必ずWire.begin();の後である必要がある。
bool Tle493d::begin(){
  bool result;
  //基本的にアドレス書き換えなどしていないけど念のためリセット
  resetSenser();
  result = configSenser();
  return result;
}

//初期状態(手が触れていない状態の値と磁石の極の向き)を記録しておく
void Tle493d::calibrate(){
  uint8_t data[6];
  Wire.requestFrom(address,6);
  for (int i = 0; i < 6; ++i) {
    data[i] = Wire.read();
  }
  if((data[2] << 4)+(data[5] & 0x0F)>2047){//磁石の裏表を判定
    pole = false;
  }else{
    pole = true;
  }
  update();
  xOffset = xRaw;
  yOffset = yRaw;
  zOffset = zRaw;
  z=0;
}

/*センサにリセットシグナルを送る。*/
void Tle493d::resetSenser(){
  Wire.beginTransmission(address);
  Wire.write(0xFF);
  Wire.endTransmission();
  Wire.beginTransmission(address);
  Wire.write(0xFF);
  Wire.endTransmission();
  Wire.beginTransmission(address);
  Wire.write(0x00);
  Wire.endTransmission();
  Wire.beginTransmission(address);
  Wire.write(0x00);
  Wire.endTransmission();
  delayMicroseconds(50);
}

/*センサのアドレス部分しか書き換えていないので、パリティビットは決め打ち
アドレスはデフォルトから変更ないけど念のため*/
bool Tle493d::configSenser(){
  byte error;
  uint8_t config = 0b00101000;
  uint8_t mod1 = 0b00010101;

  //[7]parity[6:5]IICAdr
  switch (address)
  {
    case TLE493D_A1:
      mod1 |= (0b101 << 5);
      break;
    
    case TLE493D_A2:
      mod1 |= (0b110 << 5);
      break;

    case TLE493D_A3:  
      mod1 |= (0b011 << 5);

    default:
      break;
  }

  Wire.beginTransmission(address);
  Wire.write(0x10);
  Wire.write(config);
  Wire.write(mod1);
  error = Wire.endTransmission();
  if(error == 0){
    return true;
  }else{
    return false;
  }
}

/*アソビ範囲内にある値の補正*/
int Tle493d::asobiAdj(int axis){
  int axisAdj;
  if(r < asobi/2){
    axisAdj = 0;
  }else if(r < asobi){
    axisAdj = axis * (2 - asobi/r);
  }
  return axisAdj;
}

/*状態更新*/
void Tle493d::update(){
  uint8_t data[6];
  int transformedData1[3];
  float lpf = 0;
  float adj = 0;

  Wire.requestFrom(address,6);
  for (int i = 0; i < 6; ++i) {
    data[i] = Wire.read();
  }

  transformedData1[0] = (data[0] << 4)+((data[4] & 0xF0) >> 4);
  transformedData1[1] = (data[1] << 4)+(data[4] & 0x0F);
  transformedData1[2] = (data[2] << 4)+(data[5] & 0x0F);

  for (int i = 0; i < 3; ++i) {
    if (transformedData1[i] > 2047) transformedData1[i] -= 4096;

  }
  if(!pole){//磁石の裏表によって値を反転
    xRaw = transformedData1[1];
    yRaw = transformedData1[0];
    zRaw = -transformedData1[2];
  }else{
    xRaw = -transformedData1[1];
    yRaw = -transformedData1[0];
    zRaw = transformedData1[2];
  }
    
  r = sqrt(pow(xRaw,2) + pow(yRaw,2));
  xPrev = x;
  yPrev = y;
  zPrev = z;
  if (r < (float)asobi){//アソビの範囲内なら
    lpf = 0.2 + 0.8*(r/asobi);//中心に近いほどLPFが強くかかる
    x = (int)(xPrev*(1-lpf) + asobiAdj(xRaw)*lpf);//LPFに加え、0に近いほど0に向かおうとする
    y = (int)(yPrev*(1-lpf) + asobiAdj(yRaw)*lpf);//LPFに加え、0に近いほど0に向かおうとする
  }else{
    x = xRaw;
    y = yRaw;
  }
  z = (int)(zPrev*0.7 + (zRaw-zOffset)*0.3);
}

//謎のビットマップ
const unsigned char secret[] PROGMEM = {
	0xff, 0xff, 0xff, 0xff, 0xff, 0xff, 0xff, 0xff, 0xff, 0xff, 0xff, 0xff, 0xff, 0xff, 0xff, 0xff, 
	0xff, 0xff, 0xff, 0xff, 0xff, 0xff, 0xff, 0xff, 0xff, 0xff, 0xff, 0xff, 0xff, 0xff, 0xff, 0xff, 
	0xff, 0xff, 0xff, 0xff, 0xff, 0xff, 0xff, 0xff, 0xff, 0xff, 0xff, 0xff, 0xff, 0xff, 0xff, 0xff, 
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	0xff, 0xff, 0xff, 0xff, 0xff, 0xff, 0xff, 0xff, 0xff, 0xff, 0xff, 0xff, 0xff, 0xff, 0xff, 0xff
};

//オープニング演出時の文字列
char ichiken[][20] = {"Intuitive","Controller with","Hall-sensor","Interface","Kit for","Enhanced","Navigation"};